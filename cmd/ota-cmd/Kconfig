## cmd/ota-cmd/Kconfig
```kconfig
menu "Console Command: OTA"

    config OTA_CMD_USE_ESP_HTTPS_OTA
        bool "Use high-level esp_https_ota APIs."
        default n
        select ESP_HTTPS_OTA_ALLOW_HTTP
        help
            Use high-level esp_https_ota APIs rather than low-level esp_ota APIs.
            Will enable ESP_HTTPS_OTA_ALLOW_HTTP as well.

    config OTA_CMD_SKIP_VERSION_CHECK
        bool "OTA Skip Version Check"
        default y
        help
            Do not check new app version, always do upgrade.

endmenu
```

## cmd/ota-cmd/examples/wifi_ota/sdkconfig.defaults
```kconfig
CONFIG_ESPTOOLPY_FLASHSIZE_4MB=y
CONFIG_PARTITION_TABLE_CUSTOM=y
CONFIG_PARTITION_TABLE_CUSTOM_FILENAME="partitions_ota.csv"

CONFIG_WIFI_CMD_BASIC_ONLY=y

CONFIG_COMPILER_OPTIMIZATION_SIZE=y
```

## cmd/sys-cmd/Kconfig
```kconfig
menu "Console Command: SYS"

    config SYS_CMD_LOG_MODULE
        string "log module name for sys-cmd"
        default "SYS"
        help
            "set sys-cmd log output module name"

    config SYS_CMD_SUPPORT_NVS
        bool "Support nvs command."
        default n
        help
            Support nvs set/get commands

    config SYS_CMD_SUPPORT_DSLEEP
        bool "Support dsleep command."
        depends on !IDF_TARGET_LINUX
        default y
        help
            Support basic "dsleep" (deep sleep) commands
            linux target does not support dsleep commands

    config SYS_CMD_HEAP_MALLOC_MAX_COUNT
        int "Maximum count from heap malloc command"
        default 5
        help
            Maximum count from "heap malloc" command, maximum index will be "count - 1"

endmenu
```

## cmd/utils/Kconfig
```kconfig
menu "QA utils"
    menu "qa-utils component enabled"
        visible if 0
        config QA_UTILS_ENABLED
            bool
            default y
    endmenu

    config QA_TEST_LOG_TAG
        string "Specify the tag name to be used in test logs"
        default "test"
        help
            "set log tag for QA_TEST_LOG"

    config QA_TEST_LOG_TIMESTAMP
        bool "Show timestamp for test logs"
        default n
        help
            "Show timestamp for test logs."

    choice QA_UTILS_LOG_OUTPUT
        prompt "Select the logging method for qa_utils_log_writev"
        default QA_UTILS_LOG_OUTPUT_ESP_LOG

        config QA_UTILS_LOG_OUTPUT_PRINTF
            bool
            prompt "printf"

        config QA_UTILS_LOG_OUTPUT_ESP_LOG
            bool
            prompt "esp_log"
    endchoice

endmenu
```
